## projects/espressif-esp-mosaico/corallium-firmware/overlay/components/corallium/Kconfig
```kconfig
menu "Corallium"
    config CORALLIUM_PERF_LOG
        bool "Log five-second native renderer frame and busy-time samples"
        default n
        help
            Emits corallium_perf JSON records for tools/analyze_performance.py.
            Enable only while measuring; it adds serial I/O and is not an FPS guarantee.
endmenu
```

## projects/espressif-esp-mosaico/corallium-firmware/overlay/components/mosaico_diagnostics/Kconfig
```kconfig
menu "Mosaico USB diagnostics"

config MOSAICO_USB_DIAGNOSTICS
    bool "Enable bounded USB CDC diagnostics"
    depends on TINYUSB_CDC_ENABLED
    default y
    help
        Read the existing USB CDC console without enabling the Claw CLI.
        Fixed commands expose public status, queued UI input, and a real-frame
        capture provider when available. Input is never echoed. This debug
        interface is local USB only; ordinary Corallium BLE is unchanged.

endmenu
```
